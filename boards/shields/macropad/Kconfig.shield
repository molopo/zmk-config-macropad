## boards/shields/macropad/Kconfig.shield
```kconfig
# No whitespace after the comma or in your part name!
config SHIELD_MACROPAD_LEFT
    def_bool $(shields_list_contains,macropad_left)

# No whitespace after the comma or in your part name!
config SHIELD_MACROPAD_RIGHT
    def_bool $(shields_list_contains,macropad_right)
```

## config/west.yml
```yaml
manifest:
    remotes:
        - name: zmkfirmware
          url-base: https://github.com/zmkfirmware
        - name: macropad-shield
          url-base: https://github.com/molopo/
    projects:
        - name: zmk
          remote: zmkfirmware
          revision: main
          import: app/west.yml
        - name: macropad-shield-module
          remote: macropad-shield
    self:
        path: config
```
